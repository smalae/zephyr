## drivers/spi/Kconfig.silabs_siwx91x_gspi
```kconfig
# Copyright (c) 2025 Silicon Laboratories Inc.
# SPDX-License-Identifier: Apache-2.0

config SPI_SILABS_SIWX91X_GSPI
	bool "Silabs GSPI SPI Primary controller driver"
	default y
	depends on DT_HAS_SILABS_SIWX91X_GSPI_ENABLED
	select PINCTRL
	help
	  Enable the GSPI SPI primary driver for the Silabs SiWx91x SoC series.

if SPI_SILABS_SIWX91X_GSPI

config SPI_SILABS_SIWX91X_GSPI_DMA
	bool "SIWX91X MCU GSPI DMA Support"
	select DMA
	select CACHE_MANAGEMENT if CPU_HAS_DCACHE
	help
	  Enable DMA support for SIWX91X MCU GSPI driver.

endif #SPI_SILABS_SIWX91X_GSPI
```

## dts/bindings/adc/silabs,siwx91x-adc.yaml
```yaml
description: Silicon Labs siwx91x ADC

compatible: "silabs,siwx91x-adc"

include: adc-controller.yaml

properties:
  reg:
    required: true

  interrupts:
    required: true

  silabs,adc-ref-voltage:
    type: int
    description: |
        ADC reference volatge in mv. This voltage is common for all
        the channels.
        min value - 1800
        max value - 3600
    required: true
```

## dts/bindings/dma/silabs,siwx91x-gpdma.yaml
```yaml
description: Silabs SiWx91x GPDMA

compatible: "silabs,siwx91x-gpdma"

include: dma-controller.yaml

properties:
  reg:
    required: true

  silabs,channel-reg-base:
    type: int
    const: 0x21081004
    description: |
        Base address for channel specific registers.

  silabs,dma-channel-count:
    type: int
    const: 8
    description: |
        Base address for channel specific registers.

  "#dma-cells":
    const: 2

# Parameter syntax
dma-cells:
  - channel
  - slot
```

## dts/bindings/pwm/silabs,siwx91x-pwm.yaml
```yaml
description: |
  Silabs siwx91x PWM Controller

  The siwx91x PWM controller is designed to generate PWM signals. The mapping
  between PWM channels and GPIO pins is configured through pinctrl settings.

compatible: "silabs,siwx91x-pwm"

include: [base.yaml, pinctrl-device.yaml, pwm-controller.yaml]

properties:
  "#pwm-cells":
    const: 3

  silabs,ch_prescaler:
    type: array
    required: true
    description: |
      Contains the prescaler values for all the 4 channels
    enum:
      - 1
      - 2
      - 4
      - 8
      - 16
      - 32
      - 64

pwm-cells:
  - channel
  - period
  - flags
```

## tests/drivers/spi/spi_loopback/testcase.yaml
```yaml
common:
  depends_on: spi
  tags:
    - drivers
    - spi
    - dma
  filter: dt_compat_enabled("test-spi-loopback-slow") and
          dt_compat_enabled("test-spi-loopback-fast")
  harness: ztest
  harness_config:
    fixture: spi_loopback
tests:
  drivers.spi.loopback: {}
```
